## board/egf/3sm1008/Kconfig
```kconfig
if TARGET_EGF_3SM1008

config SYS_BOARD
	default "3sm1008"

config SYS_VENDOR
	default "egf"

config SYS_CONFIG_NAME
	default "egf_3sm1008"

config IMX_CONFIG
	default "board/freescale/imx8mm_evk/imximage-8mm.cfg"

config MFG_EMB_DDR
	bool "Force embedded DDR Memory timings without reading EEPROM"
	default n


choice MFG_WID_OPTIONS
	prompt "Select WID to force embedded DDR timings"
	depends on MFG_EMB_DDR

	config FORCE_WID0670AA0101
		bool "Select WID0670_AA01.01"

endchoice

endif
```

## board/egf/3sm1009/Kconfig
```kconfig
if TARGET_EGF_3SM1009

config SYS_BOARD
	default "3sm1009"

config SYS_VENDOR
	default "egf"

config SYS_CONFIG_NAME
	default "egf_3sm1009"

config IMX_CONFIG
	default "board/freescale/imx8mp_evk/imximage-8mp-lpddr4.cfg"

config MFG_EMB_DDR
	bool "Force embedded DDR Memory timings without reading EEPROM"
	default n


choice MFG_WID_OPTIONS
	prompt "Select WID to force embedded DDR timings"
	depends on MFG_EMB_DDR

	config FORCE_WID0800AA0101
		bool "Select WID0800_AA01.01"

	config FORCE_WID0800AB0101
		bool "Select WID0800_AB01.01"


endchoice

endif
```

## board/egf/3sm1010/Kconfig
```kconfig
if TARGET_EGF_3SM1010

config SYS_BOARD
	default "3sm1010"

config SYS_VENDOR
	default "egf"

config SYS_CONFIG_NAME
	default "egf_3sm1010"

config IMX_CONFIG
	default "arch/arm/mach-imx/imx9/imximage.cfg"

config MFG_EMB_DDR
	bool "Force embedded DDR Memory timings without reading EEPROM"
	default n

config 3SM1010_LPDDR4X
	bool "Using LPDDR4X Timing and PMIC voltage"
	default y
	select IMX9_LPDDR4X
	help
	  Select the LPDDR4X timing and 0.6V VDDQ

choice MFG_WID_OPTIONS
	prompt "Select WID to force embedded DDR timings"
	depends on MFG_EMB_DDR

	config FORCE_WID0820AA0101
		bool "Select WID0820_AA01.01"
	config FORCE_WID0820AB0101
		bool "Select WID0820_AB01.01"
endchoice

endif
```

## board/egf/3sm2008/Kconfig
```kconfig
if TARGET_EGF_3SM2008

config SYS_BOARD
	default "3sm2008"

config SYS_VENDOR
	default "egf"

config SYS_CONFIG_NAME
	default "egf_3sm2008"

config IMX_CONFIG
	default "board/freescale/imx8mp_evk/imximage-8mp-lpddr4.cfg"

config MFG_EMB_DDR
	bool "Force embedded DDR Memory timings without reading EEPROM"
	default n


choice MFG_WID_OPTIONS
	prompt "Select WID to force embedded DDR timings"
	depends on MFG_EMB_DDR

	config FORCE_WID0700AA0101
		bool "Select WID0700_AA01.01"
	config FORCE_WID0700AB0101
		bool "Select WID0700_AB01.01"


endchoice

endif
```

## board/egf/3sm2010/Kconfig
```kconfig
if TARGET_EGF_3SM2010

config SYS_BOARD
	default "3sm2010"

config SYS_VENDOR
	default "egf"

config SYS_CONFIG_NAME
	default "egf_3sm2010"

config IMX_CONFIG
	default "board/freescale/imx8mm_evk/imximage-8mm.cfg"

config MFG_EMB_DDR
	bool "Force embedded DDR Memory timings without reading EEPROM"
	default n


choice MFG_WID_OPTIONS
	prompt "Select WID to force embedded DDR timings"
	depends on MFG_EMB_DDR

	config FORCE_WID0727AB0101
		bool "Select WID0727_AB01.01"

endchoice

endif
```

## board/maselettronica/imx93_nei000x0/Kconfig
```kconfig
if TARGET_IMX93_NEI000X0

config SYS_BOARD
	default "imx93_nei000x0"

config SYS_VENDOR
	default "maselettronica"

config SYS_CONFIG_NAME
	default "imx93_nei000x0"

config IMX93_EVK_LPDDR4X
	bool "Using LPDDR4X Timing and PMIC voltage"
	default y
	select IMX9_LPDDR4X
	help
	  Select the LPDDR4X timing and 0.6V VDDQ

endif
```
